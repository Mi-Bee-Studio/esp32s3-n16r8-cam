## sdkconfig.defaults
```kconfig
# Target
CONFIG_IDF_TARGET="esp32s3"

# CPU
CONFIG_ESP32S3_DEFAULT_CPU_FREQ_240=y
CONFIG_ESP32S3_DEFAULT_CPU_FREQ_MHZ=240

# PSRAM (8MB Octal) — VERBATIM from verified seeed-esp32s3-cam config
CONFIG_SPIRAM=y
CONFIG_SPIRAM_MODE_OCT=y
CONFIG_SPIRAM_BOOT_INIT=y
CONFIG_SPIRAM_USE_MALLOC=y
CONFIG_SPIRAM_MALLOC_ALWAYSINTERNAL=16384
CONFIG_SPIRAM_MALLOC_RESERVE_INTERNAL=32768
CONFIG_SPIRAM_ALLOW_STACK_EXTERNAL_MEMORY=y
# 64B cache line is MANDATORY for Octal DDR mode. 32B causes silent data corruption.
CONFIG_ESP32S3_DATA_CACHE_LINE_64B=y

# Flash 16MB (N16 variant)
CONFIG_ESPTOOLPY_FLASHSIZE_16MB=y
CONFIG_ESPTOOLPY_FLASHSIZE="16MB"

# Watchdog
CONFIG_ESP_TASK_WDT=y
CONFIG_ESP_TASK_WDT_TIMEOUT_S=10
CONFIG_ESP_TASK_WDT_CHECK_IDLE_TASK_CPU0=y
CONFIG_ESP_TASK_WDT_CHECK_IDLE_TASK_CPU1=y

# Camera — GOOUUU pin mapping (NOT XIAO/seeed)
CONFIG_CAMERA_PIN_PWDN=-1
CONFIG_CAMERA_PIN_RESET=-1
CONFIG_CAMERA_PIN_XCLK=15
CONFIG_CAMERA_PIN_SIOD=4
CONFIG_CAMERA_PIN_SIOC=5
CONFIG_CAMERA_PIN_D0=11
CONFIG_CAMERA_PIN_D1=9
CONFIG_CAMERA_PIN_D2=8
CONFIG_CAMERA_PIN_D3=10
CONFIG_CAMERA_PIN_D4=12
CONFIG_CAMERA_PIN_D5=18
CONFIG_CAMERA_PIN_D6=17
CONFIG_CAMERA_PIN_D7=16
CONFIG_CAMERA_PIN_VSYNC=6
CONFIG_CAMERA_PIN_HREF=7
CONFIG_CAMERA_PIN_PCLK=13
CONFIG_CAMERA_PSRAM_DMA=n

# Wi-Fi
CONFIG_ESP_WIFI_AMPDU_TX_ENABLED=n
CONFIG_ESP_WIFI_AMPDU_RX_ENABLED=n

# LWIP
CONFIG_LWIP_MAX_SOCKETS=10
CONFIG_LWIP_SO_REUSE=y
CONFIG_LWIP_SO_REUSE_RXTOALL=y

# Logging
CONFIG_LOG_DEFAULT_LEVEL_INFO=y
CONFIG_LOG_DEFAULT_LEVEL=3
CONFIG_LOG_COLORS=y

# FreeRTOS
CONFIG_FREERTOS_HZ=1000
CONFIG_FREERTOS_MAX_TASK_NAME_LEN=16
CONFIG_FREERTOS_DEFAULT_TASK_STACK_SIZE=4096
CONFIG_ESP_MAIN_TASK_STACK_SIZE=8192

# Partition table (custom for 16MB Flash)
CONFIG_PARTITION_TABLE_CUSTOM=y
CONFIG_PARTITION_TABLE_CUSTOM_FILENAME="partitions.csv"

# SPIFFS
CONFIG_SPIFFS=y

# WebSocket transport
CONFIG_WS_TRANSPORT=y

# C++ support (required by ESP-DL)
CONFIG_COMPILER_CXX_EXCEPTIONS=y
CONFIG_COMPILER_CXX_RTTI=y

# ESP-DL model location (in flash, not PSRAM)
CONFIG_HUMAN_FACE_DETECT_MODEL_IN_FLASH_RODATA=y
CONFIG_FLASH_HUMAN_FACE_DETECT_MSRMNP_S8_V1=y
```
